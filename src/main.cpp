/*
 * PROJECT: CYBER-TETRIS WEARABLE [ULTIMATE - BROWNOUT SAFE V4.0]
 * HARDWARE: ESP32-C3 SuperMini + 8x8 WS2812B + 0.42" OLED
 */

#include <Arduino.h>
#include <Adafruit_NeoPixel.h>
#include <U8g2lib.h>
#include <Bounce2.h>
#include <Wire.h>

// --- CONFIGURAZIONE HARDWARE ---
#define PIN_LED 10
#define PIN_BTN_L 1
#define PIN_BTN_R 0
#define PIN_BTN_ROT 3
#define PIN_BTN_DROP 4

#define NUM_LEDS 64
#define BRIGHTNESS 15 // LUMINOSITÀ DI SICUREZZA ABBASSATA
#define WIDTH 8
#define HEIGHT 8

const bool INVERT_Y = true;
const bool INVERT_X = false;
const bool IS_ZIGZAG = false;

// --- OGGETTI ---
U8G2_SSD1306_72X40_ER_F_HW_I2C u8g2(U8G2_R0, U8X8_PIN_NONE);
Adafruit_NeoPixel matrix(NUM_LEDS, PIN_LED, NEO_GRB + NEO_KHZ800);

Bounce2::Button btnL = Bounce2::Button();
Bounce2::Button btnR = Bounce2::Button();
Bounce2::Button btnRot = Bounce2::Button();
Bounce2::Button btnDrop = Bounce2::Button();

// --- STATI E VARIABILI GIOCO ---
enum State
{
  STATE_WEARABLE,
  STATE_GAME,
  STATE_GAMEOVER
};
State currentState = STATE_WEARABLE;

uint32_t grid[WIDTH][HEIGHT];
int score = 0;
int linesCleared = 0;
unsigned long lastDropTime = 0;
int dropInterval = 800;

// --- VARIABILI EFFETTI ---
int currentEffect = 0;
#define TOTAL_EFFECTS 10
unsigned long effectTimer = 0;

int stepCounter = 0;
bool spiralReverse = false;
int fillArray[64];
int filledCount = 0;
float dotX = 3.5, dotY = 3.5;
float targetX = 3.5, targetY = 3.5;
int textScrollPos = 8;

// --- ANIMAZIONE NUVOLA (STRESS TEST I2C) ---
#define FRAME_DELAY 42
#define FRAME_WIDTH 32
#define FRAME_HEIGHT 32
#define FRAME_COUNT 25
unsigned long oledAnimTimer = 0;
int currentFrame = 0;

const uint8_t frames_cloud[25][128] PROGMEM = {
    {0, 0, 0, 0, 0, 0, 0, 0, 0, 48, 0, 0, 0,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 0, 0},
    {0, 0, 0, 0, 0, 0, 0, 0, 0, 16, 0, 0, 0,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 0, 0},
    {0, 0, 0, 0, 0, 0, 0, 0, 0, 16, 0, 0, 0,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 0, 0},
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    {0, 0, 0, 0, 0, 0, 0, 0, 0, 64, 0, 0, 0,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 0, 0}};

// ANIMAZIONE 2: Running Infinity (28 Frame) - Da usare con Effetto 3
const uint8_t frames_infinity[28][128] PROGMEM = {
    {0, 0, 0, 0, 0, 0, 0, 0, 0, 0, 0, 0, 0,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 0, 0},
    {0, 0, 0, 0, 0, 0, 0, 0, 0, 0, 0, 0, 0,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 0, 0},
    {0, 0, 0, 0, 0, 0, 0, 0, 0, 0, 0, 0, 0,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 0, 0},
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    {0, 0, 0, 0, 0, 0, 0, 0, 0, 0, 0, 0, 0,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 0, 0}};

// ANIMAZIONE 3: Eye (24 Frame) - Da usare con Effetto 4
const uint8_t frames_eye[][128] PROGMEM = {
    {0, 0, 0, 0, 0, 0, 0, 0, 0, 0, 0, 0, 0,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 0, 0},
    {0, 0, 0, 0, 0, 0, 0, 0, 0, 0, 0, 0, 0,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 0, 0},
    {0, 0, 0, 0, 0, 0, 0, 0, 0, 0, 0, 0, 0,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 0, 0},
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    {0, 0, 0, 0, 0, 0, 0, 0, 0, 0, 0, 0, 0,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 0, 0}};

// Animazione 4: Activity (20 Frame) -> Effetto 5
const uint8_t frames_activity[20][128] PROGMEM = {
    {0, 0, 0, 0, 0, 0, 0, 0, 0, 0, 0, 0, 0,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 0, 0},
    {0, 0, 0, 0, 0, 0, 0, 0, 0, 0, 0, 0, 0,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 0, 0},
    {0, 0, 0, 0, 0, 0, 0, 0, 0, 0, 0, 0, 0,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 0, 0},
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    {0, 0, 0, 0, 0, 0, 0, 0, 0, 0, 0, 0, 0,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 0, 0}};

// Animazione 5: Clock (24 Frame) -> Effetto 6
const uint8_t frames_clock[24][128] PROGMEM = {
    {0, 0, 0, 0, 0, 7, 224, 0, 0, 63, 252, 0, 0,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 0, 0},
    {0, 0, 0, 0, 0, 7, 224, 0, 0, 63, 252, 0, 0,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 0, 0},
    {0, 0, 0, 0, 0, 7, 224, 0, 0, 63, 252, 0, 0,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 0, 0},
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    {0, 0, 0, 0, 0, 7, 224, 0, 0, 63, 252, 0, 0,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 0, 0}};

// Animazione 6: Rocket (24 Frame) -> Effetto 7
const uint8_t frames_rocket[24][128] PROGMEM = {
    {0, 0, 0, 0, 0, 0, 0, 126, 0, 0, 1, 194, 0,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 0, 0},
    {0, 0, 0, 0, 0, 0, 0, 126, 0, 0, 1, 194, 0,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 0, 0},
    {0, 0, 0, 0, 0, 0, 0, 126, 0, 0, 1, 194, 0,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 0, 0},
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    {0, 0, 0, 0, 0, 0, 0, 126, 0, 0, 3, 194, 0,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 0, 0}};

// Animazione 7: Diamond (20 Frame) -> Effetto 8
const uint8_t frames_diamond[20][128] PROGMEM = {
    {0, 0, 0, 0, 0, 0, 0, 0, 0, 127, 254, 0, 0,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 0, 0},
    {0, 0, 0, 0, 0, 0, 0, 0, 0, 127, 254, 0, 0,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 0, 0},
    {0, 0, 0, 0, 0, 0, 0, 0, 0, 255, 254, 0, 1,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 0, 0},
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    {0, 0, 0, 0, 0, 127, 254, 0, 0, 240, 243, 0, 1,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 0, 0}};

// Animazione 8: Ghost (24 Frame) -> Effetto 9
const uint8_t frames_ghost[24][128] PROGMEM = {
    {0, 0, 0, 0, 0, 0, 0, 0, 0, 0, 0, 0, 0,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 192, 0},
    {0, 0, 0, 0, 0, 0, 0, 0, 0, 0, 0, 0, 0,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 192, 0},
    {0, 0, 0, 0, 0, 0, 0, 0, 0, 0, 0, 0, 0,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 128, 0},
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    {0, 0, 0, 0, 0, 0, 0, 0, 0, 7, 224, 0, 0,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 0, 0}};

// Animazione 9: Walk (15 Frame) -> Effetto 10
const uint8_t frames_walk[15][128] PROGMEM = {
  {0,0,0,0,0,0,224,0,0,1,240,0,0,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0,0},
  {0,0,0,0,0,0,224,0,0,1,240,0,0,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0,0},
  {0,0,0,0,0,0,224,0,0,1,240,0,0,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0,0},
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  {0,0,0,0,0,0,224,0,0,1,240,0,0,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0,0}
};
    // FIX: Mappa Spirale corretta (Esattamente 64 elementi calcolati)
const int SPIRAL_MAP[64] = {
    0, 1, 2, 3, 4, 5, 6, 7, 15, 23, 31, 39, 47, 55, 63, 62, 61, 60, 59, 58, 57, 56, 48, 40, 32, 24, 16, 8,
    9, 10, 11, 12, 13, 14, 22, 30, 38, 46, 54, 53, 52, 51, 50, 49, 41, 33, 25, 17,
    18, 19, 20, 21, 29, 37, 45, 44, 43, 42, 34, 26, 27, 28, 36, 35};

const int TEXT_LEN = 40;
const uint8_t TEO_ZEN[40] = {
    0x01, 0x01, 0x7F, 0x01, 0x01, 0x00,             // T
    0x7F, 0x49, 0x49, 0x49, 0x41, 0x00,             // E
    0x3E, 0x41, 0x41, 0x41, 0x3E, 0x00, 0x00, 0x00, // O + space
    0x61, 0x51, 0x49, 0x45, 0x43, 0x00,             // Z
    0x7F, 0x49, 0x49, 0x49, 0x41, 0x00,             // E
    0x7F, 0x04, 0x08, 0x10, 0x7F, 0x00, 0x00, 0x00  // N
};

const uint32_t COLORS[] = {0x00FFFF, 0x0000FF, 0xFFA500, 0xFFFF00, 0x00FF00, 0x800080, 0xFF0000};
const int SHAPES[7][8] = {
    {-1, 0, 0, 0, 1, 0, 2, 0}, {-1, -1, -1, 0, 0, 0, 1, 0}, {1, -1, -1, 0, 0, 0, 1, 0}, {0, 0, 1, 0, 0, 1, 1, 1}, {-1, 1, 0, 1, 0, 0, 1, 0}, {-1, 0, 0, 0, 1, 0, 0, 1}, {-1, 0, 0, 0, 0, 1, 1, 1}};
struct Piece
{
  int x, y, type, rotation;
  uint32_t color;
} playerPiece;

// Prototipi
void resetGame();
void spawnPiece(Piece &p);
bool isValid(Piece p, int dx, int dy, int newRot);
void lockPiece(Piece &p);
void checkLines();
void drawGame();
void runGameLogic();
void runWearableEffects();
void getBlockPos(int type, int rot, int pIdx, int &rx, int &ry);
int getPixelIndex(int x, int y);
void effectAIDemo();
void effectRainbowVertical();
void effectMatrixRain();
void effectStrobe();
void effectWarmPulse();
void effectSpiral();
void effectStarrySky();
void effectRandomFill();
void effectWanderingDot();
void effectScrollingText();

void setup()
{
  Wire.begin(5, 6);
  Wire.setClock(400000);
  u8g2.begin();
  matrix.begin();
  matrix.setBrightness(BRIGHTNESS); // Fissata a 15
  matrix.show();

  btnL.attach(PIN_BTN_L, INPUT_PULLUP);
  btnR.attach(PIN_BTN_R, INPUT_PULLUP);
  btnRot.attach(PIN_BTN_ROT, INPUT_PULLUP);
  btnDrop.attach(PIN_BTN_DROP, INPUT_PULLUP);
  btnL.interval(5);
  btnR.interval(5);
  btnRot.interval(5);
  btnDrop.interval(5);

  randomSeed(analogRead(2) + millis());
  for (int i = 0; i < 64; i++)
    fillArray[i] = i;

  resetGame();
  currentState = STATE_WEARABLE;
  currentEffect = 0;
}

void loop()
{
  btnL.update();
  btnR.update();
  btnRot.update();
  btnDrop.update();

  switch (currentState)
  {
  case STATE_WEARABLE:
    if (btnL.pressed())
    {
      currentEffect--;
      if (currentEffect < 0)
        currentEffect = TOTAL_EFFECTS - 1;
      matrix.clear();
      resetGame();
      stepCounter = 0;
      filledCount = 0;
      currentFrame = 0;
    }
    if (btnR.pressed())
    {
      currentEffect++;
      if (currentEffect >= TOTAL_EFFECTS)
        currentEffect = 0;
      matrix.clear();
      resetGame();
      stepCounter = 0;
      filledCount = 0;
      currentFrame = 0;
    }

    if (btnDrop.pressed())
    {
      resetGame();
      currentState = STATE_GAME;
      matrix.setBrightness(BRIGHTNESS);
      for (int i = 0; i < 3; i++)
      {
        matrix.fill(matrix.Color(50, 50, 50));
        matrix.show();
        delay(100);
        matrix.clear();
        matrix.show();
        delay(100);
      }
    }

    // 1. Aggiorna i LED
    runWearableEffects();

    // 2. Aggiorna il Display (ANIMAZIONI MULTIPLE)
    if (currentEffect == 1)
    {
      // EFFETTO 2: Arcobaleno LED + Nuvola OLED
      if (millis() - oledAnimTimer >= FRAME_DELAY)
      {
        oledAnimTimer = millis();
        currentFrame = (currentFrame + 1) % 25; // 25 Frame della Nuvola

        u8g2.clearBuffer();
        u8g2.drawBitmap(20, 4, 4, FRAME_HEIGHT, frames_cloud[currentFrame]);
        u8g2.sendBuffer();
      }
    }
    else if (currentEffect == 2)
    {
      // EFFETTO 3: Matrix Rain LED + Running Infinity OLED
      if (millis() - oledAnimTimer >= FRAME_DELAY)
      {
        oledAnimTimer = millis();
        currentFrame = (currentFrame + 1) % 28; // 28 Frame dell'Infinito

        u8g2.clearBuffer();
        u8g2.drawBitmap(20, 4, 4, FRAME_HEIGHT, frames_infinity[currentFrame]);
        u8g2.sendBuffer();
      }
    }
    else if (currentEffect == 3)
    {
      // EFFETTO 4: Stroboscopio Glitch LED + Occhio OLED
      if (millis() - oledAnimTimer >= FRAME_DELAY)
      {
        oledAnimTimer = millis();
        currentFrame = (currentFrame + 1) % 24; // 24 Frame dell'Occhio

        u8g2.clearBuffer();
        u8g2.drawBitmap(20, 4, 4, FRAME_HEIGHT, frames_eye[currentFrame]);
        u8g2.sendBuffer();
      }
    }
    else if (currentEffect == 4)
    {
      // EFFETTO 5: Warm Pulse LED + Activity OLED
      if (millis() - oledAnimTimer >= FRAME_DELAY)
      {
        oledAnimTimer = millis();
        currentFrame = (currentFrame + 1) % 20; // 20 Frame di Activity

        u8g2.clearBuffer();
        u8g2.drawBitmap(20, 4, 4, FRAME_HEIGHT, frames_activity[currentFrame]);
        u8g2.sendBuffer();
      }
    }
    else if (currentEffect == 5)
    {
      // EFFETTO 6: Spirale LED + Clock OLED
      if (millis() - oledAnimTimer >= FRAME_DELAY)
      {
        oledAnimTimer = millis();
        currentFrame = (currentFrame + 1) % 24; // 24 Frame del Clock

        u8g2.clearBuffer();
        u8g2.drawBitmap(20, 4, 4, FRAME_HEIGHT, frames_clock[currentFrame]);
        u8g2.sendBuffer();
      }
    }
    else if (currentEffect == 6)
    {
      // EFFETTO 7: Cielo Stellato LED + Rocket OLED
      if (millis() - oledAnimTimer >= FRAME_DELAY)
      {
        oledAnimTimer = millis();
        currentFrame = (currentFrame + 1) % 24; // 24 Frame del Rocket

        u8g2.clearBuffer();
        u8g2.drawBitmap(20, 4, 4, FRAME_HEIGHT, frames_rocket[currentFrame]);
        u8g2.sendBuffer();
      }
    }
    else if (currentEffect == 7)
    {
      // EFFETTO 8: Riempimento Random LED + Diamond OLED
      if (millis() - oledAnimTimer >= FRAME_DELAY)
      {
        oledAnimTimer = millis();
        currentFrame = (currentFrame + 1) % 20; // 20 Frame del Diamond

        u8g2.clearBuffer();
        u8g2.drawBitmap(20, 4, 4, FRAME_HEIGHT, frames_diamond[currentFrame]);
        u8g2.sendBuffer();
      }
    }
    else if (currentEffect == 8)
    {
      // EFFETTO 9: Wandering Dot LED + Ghost OLED
      if (millis() - oledAnimTimer >= FRAME_DELAY)
      {
        oledAnimTimer = millis();
        currentFrame = (currentFrame + 1) % 24; // 24 Frame del Ghost

        u8g2.clearBuffer();
        u8g2.drawBitmap(20, 4, 4, FRAME_HEIGHT, frames_ghost[currentFrame]);
        u8g2.sendBuffer();
      }
    }
    else if (currentEffect == 9)
    {
      // EFFETTO 10: Testo Scorrevole LED + Walk OLED
      if (millis() - oledAnimTimer >= FRAME_DELAY)
      {
        oledAnimTimer = millis();
        currentFrame = (currentFrame + 1) % 15; // 15 Frame per Walk
        u8g2.clearBuffer();
        u8g2.drawBitmap(20, 4, 4, FRAME_HEIGHT, frames_walk[currentFrame]);
        u8g2.sendBuffer();
      }
    }
    else
    {
      // MENU STANDARD PER TUTTI GLI ALTRI EFFETTI
      u8g2.clearBuffer();
      u8g2.setFont(u8g2_font_profont12_tr);
      u8g2.drawStr(15, 10, "TETRIS");
      u8g2.setFont(u8g2_font_profont10_tr);
      u8g2.setCursor(0, 25);
      u8g2.print("EFFETTO: ");
      u8g2.print(currentEffect + 1);
      u8g2.setCursor(0, 38);
      u8g2.print("[DROP] TO PLAY");
      u8g2.sendBuffer();
    }
    break;

  case STATE_GAME:
    runGameLogic();
    drawGame();
    u8g2.clearBuffer();
    u8g2.setFont(u8g2_font_profont10_tr);
    u8g2.setCursor(0, 8);
    u8g2.print("SCORE: ");
    u8g2.print(score);
    u8g2.setCursor(0, 18);
    u8g2.print("LINES: ");
    u8g2.print(linesCleared);
    u8g2.setCursor(0, 35);
    u8g2.print("LVL: ");
    u8g2.print(linesCleared / 5 + 1);
    u8g2.sendBuffer();
    break;

  case STATE_GAMEOVER:
    if (btnDrop.pressed() || btnRot.pressed())
    {
      currentState = STATE_WEARABLE;
      currentEffect = 0;
    }
    if ((millis() / 500) % 2 == 0)
    {
      u8g2.clearBuffer();
      u8g2.setFont(u8g2_font_profont12_tr);
      u8g2.drawStr(10, 15, "GAME");
      u8g2.drawStr(10, 28, "OVER");
      u8g2.setFont(u8g2_font_profont10_tr);
      u8g2.setCursor(5, 39);
      u8g2.print("SCORE: ");
      u8g2.print(score);
      u8g2.sendBuffer();
    }
    break;
  }
}

int getPixelIndex(int x, int y)
{
  if (x < 0 || x >= WIDTH || y < 0 || y >= HEIGHT)
    return -1;
  int physicalX = INVERT_X ? (WIDTH - 1 - x) : x;
  int physicalY = INVERT_Y ? (HEIGHT - 1 - y) : y;
  if (IS_ZIGZAG)
    return (physicalY % 2 == 0) ? ((physicalY * WIDTH) + physicalX) : ((physicalY * WIDTH) + (WIDTH - 1 - physicalX));
  return (physicalY * WIDTH) + physicalX;
}

void runWearableEffects()
{
  switch (currentEffect)
  {
  case 0:
    effectAIDemo();
    drawGame();
    break;
  case 1:
    effectRainbowVertical();
    break;
  case 2:
    effectMatrixRain();
    break;
  case 3:
    effectStrobe();
    break; // FIXATO!
  case 4:
    effectWarmPulse();
    break;
  case 5:
    effectSpiral();
    break;
  case 6:
    effectStarrySky();
    break;
  case 7:
    effectRandomFill();
    break;
  case 8:
    effectWanderingDot();
    break;
  case 9:
    effectScrollingText();
    break;
  }
}

void effectAIDemo()
{
  if (millis() - lastDropTime > 250)
  {
    if (isValid(playerPiece, 0, 1, playerPiece.rotation))
      playerPiece.y++;
    else
    {
      lockPiece(playerPiece);
      int bestX = playerPiece.x, bestRot = 0;
      for (int i = 0; i < 10; i++)
      {
        int rX = random(WIDTH), rRot = random(4);
        Piece test = playerPiece;
        test.x = rX;
        test.rotation = rRot;
        test.y = 0;
        if (isValid(test, 0, 0, rRot))
        {
          bestX = rX;
          bestRot = rRot;
          break;
        }
      }
      playerPiece.x = bestX;
      playerPiece.rotation = bestRot;
    }
    lastDropTime = millis();
  }
}

void effectRainbowVertical()
{
  if (millis() - effectTimer < 50)
    return;
  effectTimer = millis();
  stepCounter++;
  for (int y = 0; y < HEIGHT; y++)
  {
    uint32_t color = matrix.ColorHSV((y * 65536 / HEIGHT) + (stepCounter * 100), 255, 200);
    for (int x = 0; x < WIDTH; x++)
    {
      int idx = getPixelIndex(x, y);
      if (idx != -1)
        matrix.setPixelColor(idx, color);
    }
  }
  matrix.show();
}

void effectMatrixRain()
{
  if (millis() - effectTimer < 60)
    return;
  effectTimer = millis();
  for (int i = 0; i < NUM_LEDS; i++)
  {
    uint32_t c = matrix.getPixelColor(i);
    uint8_t r = (c >> 16) & 0xFF;
    uint8_t g = (c >> 8) & 0xFF;
    uint8_t b = c & 0xFF;
    matrix.setPixelColor(i, matrix.Color(r * 0.75, g * 0.75, b * 0.75));
  }
  for (int y = HEIGHT - 2; y >= 0; y--)
  {
    for (int x = 0; x < WIDTH; x++)
    {
      int currIdx = getPixelIndex(x, y);
      int belowIdx = getPixelIndex(x, y + 1);
      uint32_t c = matrix.getPixelColor(currIdx);
      if (((c >> 8) & 0xFF) > 100)
      {
        matrix.setPixelColor(belowIdx, matrix.Color(0, 255, 0));
        matrix.setPixelColor(currIdx, matrix.Color(0, 100, 0));
      }
    }
  }
  if (random(10) > 7)
  {
    int idx = getPixelIndex(random(WIDTH), 0);
    if (idx != -1)
      matrix.setPixelColor(idx, matrix.Color(150, 255, 150));
  }
  matrix.show();
}

// FIX DI SICUREZZA: Stroboscopio Glitch (Non fa crashare l'alimentazione)
void effectStrobe()
{
  if (millis() - effectTimer < 40)
    return;
  effectTimer = millis();
  stepCounter = !stepCounter;

  matrix.clear();
  if (stepCounter)
  {
    // Accende SOLO 8 led casuali di bianco, riducendo l'assorbimento dell'80%
    for (int i = 0; i < 8; i++)
      matrix.setPixelColor(random(64), matrix.Color(255, 255, 255));
  }
  matrix.show();
}

void effectWarmPulse()
{
  if (millis() - effectTimer < 30)
    return; // Aggiornamento fluido
  effectTimer = millis();

  // Usiamo il tempo continuo per guidare le onde
  float t = millis() / 1500.0;

  // Modulatore di velocità: varia dolcemente tra 1.0x e 3.0x
  float speedModifier = 2.0 + 1.0 * sin(t * 0.5);

  // Pulsazione liscia (onda coseno da 0.0 a 1.0)
  float pulse = (cos(t * speedModifier * 3.14) + 1.0) / 2.0;

  // Luminosità: da 20 (minimo stabile per non tremare) a 150 (picco)
  uint8_t brightness = 20 + (pulse * 130);

  // Tonalità calda: varia dolcemente da Rosso a Giallo intenso
  uint16_t hue = 5000 + 5000 * sin(t * 0.3);

  // La funzione ColorHSV crea sfumature nettamente migliori di RGB per i fade
  matrix.fill(matrix.ColorHSV(hue, 255, brightness));
  matrix.show();
}

void effectSpiral()
{
  if (millis() - effectTimer < 40)
    return;
  effectTimer = millis();
  matrix.clear();
  for (int i = 0; i <= stepCounter; i++)
  {
    int logX = SPIRAL_MAP[i] % 8;
    int logY = SPIRAL_MAP[i] / 8;
    int physIdx = getPixelIndex(logX, logY);
    uint32_t color = matrix.ColorHSV(i * 1000, 255, 200);
    if (physIdx != -1)
      matrix.setPixelColor(physIdx, color);
  }
  matrix.show();
  if (!spiralReverse)
  {
    stepCounter++;
    if (stepCounter >= 63)
      spiralReverse = true;
  }
  else
  {
    stepCounter--;
    if (stepCounter <= 0)
      spiralReverse = false;
  }
}

void effectStarrySky()
{
  if (millis() - effectTimer < 30)
    return;
  effectTimer = millis();
  for (int i = 0; i < NUM_LEDS; i++)
  {
    uint32_t c = matrix.getPixelColor(i);
    uint8_t r = (c >> 16) & 0xFF;
    uint8_t g = (c >> 8) & 0xFF;
    uint8_t b = c & 0xFF;
    if (r > 0)
      r--;
    if (g > 0)
      g--;
    if (b > 2)
      b -= 2;
    matrix.setPixelColor(i, matrix.Color(r, g, b));
  }
  if (random(100) < 10)
  {
    int idx = random(64);
    int type = random(3);
    if (type == 0)
      matrix.setPixelColor(idx, matrix.Color(100, 100, 255));
    else if (type == 1)
      matrix.setPixelColor(idx, matrix.Color(200, 200, 200));
    else
      matrix.setPixelColor(idx, matrix.Color(200, 180, 50));
  }
  matrix.show();
}

void effectRandomFill()
{
  if (millis() - effectTimer < 100)
    return;
  effectTimer = millis();
  if (filledCount == 0)
  {
    matrix.clear();
    for (int i = 63; i > 0; i--)
    {
      int j = random(i + 1);
      int temp = fillArray[i];
      fillArray[i] = fillArray[j];
      fillArray[j] = temp;
    }
  }
  int targetIdx = fillArray[filledCount];
  int logX = targetIdx % 8;
  int logY = targetIdx / 8;
  int physIdx = getPixelIndex(logX, logY);
  if (physIdx != -1)
    matrix.setPixelColor(physIdx, matrix.ColorHSV(random(65535), 255, 150));
  matrix.show();
  filledCount++;
  if (filledCount >= 64)
  {
    delay(500);
    filledCount = 0;
  }
}

void effectWanderingDot()
{
  if (millis() - effectTimer < 30)
    return;
  effectTimer = millis();
  for (int i = 0; i < NUM_LEDS; i++)
  {
    uint32_t c = matrix.getPixelColor(i);
    matrix.setPixelColor(i, matrix.Color(0, ((c >> 8) & 0xFF) * 0.8, 0));
  }
  if (abs(dotX - targetX) < 0.1 && abs(dotY - targetY) < 0.1)
  {
    targetX += random(-4, 5);
    targetY += random(-4, 5);
    if (targetX < 0)
      targetX = 0;
    if (targetX > 7)
      targetX = 7;
    if (targetY < 0)
      targetY = 0;
    if (targetY > 7)
      targetY = 7;
  }
  dotX += (targetX - dotX) * 0.2;
  dotY += (targetY - dotY) * 0.2;
  int physIdx = getPixelIndex(round(dotX), round(dotY));
  if (physIdx != -1)
    matrix.setPixelColor(physIdx, matrix.Color(0, 255, 0));
  matrix.show();
}

void effectScrollingText()
{
  if (millis() - effectTimer < 150)
    return;
  effectTimer = millis();
  matrix.clear();

  for (int x = 0; x < WIDTH; x++)
  {
    int charColIndex = textScrollPos + x;

    // Disegna solo se la colonna corrente è all'interno della mappa dei pixel
    if (charColIndex >= 0 && charColIndex < TEXT_LEN)
    {
      uint8_t colData = TEO_ZEN[charColIndex];
      for (int y = 0; y < 7; y++)
      {
        if (colData & (1 << y))
        {
          int physIdx = getPixelIndex(x, y);
          if (physIdx != -1)
            matrix.setPixelColor(physIdx, matrix.Color(0, 0, 255));
        }
      }
    }
  }
  matrix.show();

  // INVERSIONE: Decrementiamo la posizione (sposta a destra)
  textScrollPos--;

  // Se la scritta esce tutta fuori dallo schermo a destra, riparti da sinistra
  if (textScrollPos < -8)
  {
    textScrollPos = TEXT_LEN;
  }
}

// Logica Gioco e Rendering...
void drawGame()
{
  matrix.clear();
  for (int y = 0; y < HEIGHT; y++)
  {
    for (int x = 0; x < WIDTH; x++)
    {
      if (grid[x][y] != 0)
      {
        int idx = getPixelIndex(x, y);
        if (idx != -1)
          matrix.setPixelColor(idx, grid[x][y]);
      }
    }
  }
  if (currentState == STATE_GAME || currentState == STATE_WEARABLE)
  {
    for (int i = 0; i < 4; i++)
    {
      int rx, ry;
      getBlockPos(playerPiece.type, playerPiece.rotation, i, rx, ry);
      int fx = playerPiece.x + rx, fy = playerPiece.y + ry;
      int idx = getPixelIndex(fx, fy);
      if (idx != -1)
        matrix.setPixelColor(idx, playerPiece.color);
    }
  }
  matrix.show();
}

void getBlockPos(int type, int rot, int pIdx, int &rx, int &ry)
{
  int x = SHAPES[type][pIdx * 2], y = SHAPES[type][pIdx * 2 + 1];
  for (int i = 0; i < rot; i++)
  {
    int temp = x;
    x = -y;
    y = temp;
  }
  rx = x;
  ry = y;
}
bool isValid(Piece p, int dx, int dy, int newRot)
{
  for (int i = 0; i < 4; i++)
  {
    int rx, ry;
    getBlockPos(p.type, newRot, i, rx, ry);
    int fx = p.x + dx + rx, fy = p.y + dy + ry;
    if (fx < 0 || fx >= WIDTH || fy >= HEIGHT)
      return false;
    if (fy >= 0 && grid[fx][fy] != 0)
      return false;
  }
  return true;
}
void runGameLogic()
{
  if (btnL.pressed() && isValid(playerPiece, -1, 0, playerPiece.rotation))
    playerPiece.x--;
  if (btnR.pressed() && isValid(playerPiece, 1, 0, playerPiece.rotation))
    playerPiece.x++;
  if (btnRot.pressed())
  {
    int newRot = (playerPiece.rotation + 1) % 4;
    if (isValid(playerPiece, 0, 0, newRot))
      playerPiece.rotation = newRot;
  }
  if (btnDrop.pressed())
  {
    while (isValid(playerPiece, 0, 1, playerPiece.rotation))
      playerPiece.y++;
    lockPiece(playerPiece);
    lastDropTime = millis();
  }
  if (millis() - lastDropTime > dropInterval)
  {
    if (isValid(playerPiece, 0, 1, playerPiece.rotation))
      playerPiece.y++;
    else
      lockPiece(playerPiece);
    lastDropTime = millis();
  }
}
void lockPiece(Piece &p)
{
  for (int i = 0; i < 4; i++)
  {
    int rx, ry;
    getBlockPos(p.type, p.rotation, i, rx, ry);
    int fx = p.x + rx, fy = p.y + ry;
    if (fy >= 0 && fy < HEIGHT && fx >= 0 && fx < WIDTH)
      grid[fx][fy] = p.color;
  }
  checkLines();
  spawnPiece(p);
  if (!isValid(p, 0, 0, p.rotation))
  {
    if (currentState == STATE_GAME)
      currentState = STATE_GAMEOVER;
    else
      resetGame();
  }
}
void checkLines()
{
  for (int y = HEIGHT - 1; y >= 0; y--)
  {
    bool full = true;
    for (int x = 0; x < WIDTH; x++)
      if (grid[x][y] == 0)
        full = false;
    if (full)
    {
      for (int x = 0; x < WIDTH; x++)
      {
        int idx = getPixelIndex(x, y);
        if (idx != -1)
          matrix.setPixelColor(idx, matrix.Color(255, 255, 255));
      }
      matrix.show();
      delay(40);
      for (int ny = y; ny > 0; ny--)
        for (int x = 0; x < WIDTH; x++)
          grid[x][ny] = grid[x][ny - 1];
      for (int x = 0; x < WIDTH; x++)
        grid[x][0] = 0;
      score += 100;
      linesCleared++;
      dropInterval = max(100, 800 - (linesCleared * 20));
      y++;
    }
  }
}
void spawnPiece(Piece &p)
{
  p.type = random(7);
  p.rotation = 0;
  p.x = 3;
  p.y = -1;
  p.color = COLORS[p.type];
}
void resetGame()
{
  memset(grid, 0, sizeof(grid));
  score = 0;
  linesCleared = 0;
  dropInterval = 800;
  spawnPiece(playerPiece);
}